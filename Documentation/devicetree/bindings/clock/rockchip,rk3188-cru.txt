## Documentation/devicetree/bindings/clock/rockchip,rk3188-cru.txt
```
* Rockchip RK3188 Clock and Reset Unit

The RK3188 clock controller generates and supplies clock to various controllers
within the SoC and also implements a reset controller for SoC peripherals.
There exist two variants of the rk3188 SoC, the rk3188 and rk3188a, with
slight differences in the pll handling.

Required Properties:

- compatible: should be "rockchip,rk3188-cru" or "rockchip,rk3188a-cru"
- reg: physical base address of the controller and length of memory mapped
  region.
- #clock-cells: should be 1.
- #reset-cells: should be 1.

Optional Properties:

- rockchip,grf: phandle to the syscon managing the "general register files"
  If missing pll rates are not changable, due to the missing pll lock status.

Each clock is assigned an identifier and client nodes can use this identifier
to specify the clock which they consume. All available clocks are defined as
preprocessor macros in dt-bindings/clock/rk3188-cru.h header and can be used
in device tree sources.

External clocks:

There are several clocks that are generated outside the SoC. It is expected
that they are defined using standard clock bindings with following
clock-output-names:
 - "xin24m" - crystal input - required,
 - "xin32k" - rtc clock - optional,
 - "ext_hsadc" - external HSADC clock - optional,
 - "ext_cif" - external camera clock - optional,
 - "ext_rmii" - external RMII clock - optional,
 - "ext_jtag" - externalJTAG clock - optional

Example: Clock controller node:

	cru: cru@20000000 {
		compatible = "rockchip,rk3188-cru";
		reg = <0x20000000 0x1000>;
		rockchip,grf = <&grf>;

		#clock-cells = <1>;
		#reset-cells = <1>;
	};

Example: UART controller node that consumes the clock generated by the clock
  controller:

	uart0: serial@10124000 {
		compatible = "snps,dw-apb-uart";
		reg = <0x10124000 0x400>;
		interrupts = <GIC_SPI 34 IRQ_TYPE_LEVEL_HIGH>;
		reg-shift = <2>;
		reg-io-width = <1>;
		clocks = <&cru SCLK_UART0>;
	};
```

## Documentation/devicetree/bindings/clock/voltage-oscillator.yaml
```yaml
# SPDX-License-Identifier: (GPL-2.0-only OR BSD-2-Clause)
%YAML 1.2
---
$id: http://devicetree.org/schemas/clock/voltage-oscillator.yaml#
$schema: http://devicetree.org/meta-schemas/core.yaml#

title: Voltage controlled oscillator

maintainers:
  - Heiko Stuebner <heiko@sntech.de>

properties:
  compatible:
    const: voltage-oscillator

  "#clock-cells":
    const: 0

  clock-frequency: true

  clock-output-names:
    maxItems: 1

  enable-gpios:
    description:
      Contains a single GPIO specifier for the GPIO that enables and disables
      the oscillator.
    maxItems: 1

  vdd-supply:
    description: handle of the regulator that provides the supply voltage

required:
  - compatible
  - "#clock-cells"
  - clock-frequency
  - vdd-supply

additionalProperties: false

examples:
  - |
    voltage-oscillator {
      compatible = "voltage-oscillator";
      #clock-cells = <0>;
      clock-frequency = <1000000000>;
      vdd-supply = <&reg_vdd>;
    };
...
```

## Documentation/devicetree/bindings/display/bridge/synopsys,dw-hdmi-qp.yaml
```yaml
# SPDX-License-Identifier: (GPL-2.0-only OR BSD-2-Clause)
%YAML 1.2
---
$id: http://devicetree.org/schemas/display/bridge/synopsys,dw-hdmi-qp.yaml#
$schema: http://devicetree.org/meta-schemas/core.yaml#

title: Common Properties for Synopsys DesignWare HDMI QP TX Controller IP

maintainers:
  - Cristian Ciocaltea <cristian.ciocaltea@collabora.com>

description: |
  The Synopsys DesignWare HDMI 2.1 Quad-Pixel (QP) TX Controller IP core
  supports the following features, among others:

  * Fixed Rate Link (FRL)
  * Display Stream Compression (DSC)
  * 4K@120Hz and 8K@60Hz video modes
  * Variable Refresh Rate (VRR) including Quick Media Switching (QMS)
  * Fast Vactive (FVA)
  * SCDC I2C DDC access
  * Multi-stream audio
  * Enhanced Audio Return Channel (EARC)

  Note this is not a full dt-binding specification, but is meant to be
  referenced by platform-specific bindings for this IP core.

properties:
  reg:
    maxItems: 1

  clocks:
    minItems: 4
    maxItems: 6
    items:
      - description: Peripheral/APB bus clock
      - description: EARC RX biphase clock
      - description: Reference clock
      - description: Audio interface clock
    additionalItems: true

  clock-names:
    minItems: 4
    maxItems: 6
    items:
      - const: pclk
      - const: earc
      - const: ref
      - const: aud
    additionalItems: true

  interrupts:
    minItems: 4
    maxItems: 5
    items:
      - description: AVP Unit interrupt
      - description: CEC interrupt
      - description: eARC RX interrupt
      - description: Main Unit interrupt
    additionalItems: true

  interrupt-names:
    minItems: 4
    maxItems: 5
    items:
      - const: avp
      - const: cec
      - const: earc
      - const: main
    additionalItems: true

additionalProperties: true
```

## Documentation/devicetree/bindings/display/rockchip/rockchip,dw-hdmi-qp.yaml
```yaml
# SPDX-License-Identifier: (GPL-2.0-only OR BSD-2-Clause)
%YAML 1.2
---
$id: http://devicetree.org/schemas/display/rockchip/rockchip,dw-hdmi-qp.yaml#
$schema: http://devicetree.org/meta-schemas/core.yaml#

title: Rockchip DW HDMI QP TX Encoder

maintainers:
  - Cristian Ciocaltea <cristian.ciocaltea@collabora.com>

description:
  Rockchip RK3588 SoC integrates the Synopsys DesignWare HDMI QP TX controller
  IP and a HDMI/eDP TX Combo PHY based on a Samsung IP block.

allOf:
  - $ref: ../bridge/synopsys,dw-hdmi-qp.yaml#
  - $ref: /schemas/sound/dai-common.yaml#

properties:
  compatible:
    enum:
      - rockchip,rk3588-dw-hdmi-qp

  clocks:
    minItems: 4
    items:
      - {}
      - {}
      - {}
      - {}
      # The next clocks are optional, but shall be specified in this
      # order when present.
      - description: TMDS/FRL link clock
      - description: Video datapath clock

  clock-names:
    minItems: 4
    items:
      - {}
      - {}
      - {}
      - {}
      - enum: [hdp, hclk_vo1]
      - const: hclk_vo1

  interrupts:
    items:
      - {}
      - {}
      - {}
      - {}
      - description: HPD interrupt

  interrupt-names:
    items:
      - {}
      - {}
      - {}
      - {}
      - const: hpd

  phys:
    maxItems: 1
    description: The HDMI/eDP PHY.

  phy-names:
    const: hdmi

  ports:
    $ref: /schemas/graph.yaml#/properties/ports

    properties:
      port@0:
        $ref: /schemas/graph.yaml#/properties/port
        description:
          Port node with one endpoint connected to a vop node.

      port@1:
        $ref: /schemas/graph.yaml#/properties/port
        description:
          Port node with one endpoint connected to a hdmi-connector node.

    required:
      - port@0
      - port@1

  power-domains:
    maxItems: 1

  resets:
    minItems: 2
    maxItems: 2

  reset-names:
    items:
      - const: ref
      - const: hdp

  "#sound-dai-cells":
    const: 0

  rockchip,grf:
    $ref: /schemas/types.yaml#/definitions/phandle
    description:
      Most HDMI QP related data is accessed through SYS GRF regs.

  rockchip,vo1_grf:
    $ref: /schemas/types.yaml#/definitions/phandle
    description:
      Additional HDMI QP related data is accessed through VO1 GRF regs.

required:
  - compatible
  - reg
  - clocks
  - clock-names
  - interrupts
  - interrupt-names
  - phys
  - phy-names
  - ports
  - resets
  - reset-names
  - rockchip,grf
  - rockchip,vo1_grf

unevaluatedProperties: false

examples:
  - |
    #include <dt-bindings/clock/rockchip,rk3588-cru.h>
    #include <dt-bindings/interrupt-controller/arm-gic.h>
    #include <dt-bindings/interrupt-controller/irq.h>
    #include <dt-bindings/power/rk3588-power.h>
    #include <dt-bindings/reset/rockchip,rk3588-cru.h>

    soc {
      #address-cells = <2>;
      #size-cells = <2>;

      hdmi@fde80000 {
        compatible = "rockchip,rk3588-dw-hdmi-qp";
        reg = <0x0 0xfde80000 0x0 0x20000>;
        clocks = <&cru PCLK_HDMITX0>,
                 <&cru CLK_HDMITX0_EARC>,
                 <&cru CLK_HDMITX0_REF>,
                 <&cru MCLK_I2S5_8CH_TX>,
                 <&cru CLK_HDMIHDP0>,
                 <&cru HCLK_VO1>;
        clock-names = "pclk", "earc", "ref", "aud", "hdp", "hclk_vo1";
        interrupts = <GIC_SPI 169 IRQ_TYPE_LEVEL_HIGH 0>,
                     <GIC_SPI 170 IRQ_TYPE_LEVEL_HIGH 0>,
                     <GIC_SPI 171 IRQ_TYPE_LEVEL_HIGH 0>,
                     <GIC_SPI 172 IRQ_TYPE_LEVEL_HIGH 0>,
                     <GIC_SPI 360 IRQ_TYPE_LEVEL_HIGH 0>;
        interrupt-names = "avp", "cec", "earc", "main", "hpd";
        phys = <&hdptxphy_hdmi0>;
        phy-names = "hdmi";
        power-domains = <&power RK3588_PD_VO1>;
        resets = <&cru SRST_HDMITX0_REF>, <&cru SRST_HDMIHDP0>;
        reset-names = "ref", "hdp";
        rockchip,grf = <&sys_grf>;
        rockchip,vo1_grf = <&vo1_grf>;
        #sound-dai-cells = <0>;

        ports {
          #address-cells = <1>;
          #size-cells = <0>;

          port@0 {
            reg = <0>;

            hdmi0_in_vp0: endpoint {
                remote-endpoint = <&vp0_out_hdmi0>;
            };
          };

          port@1 {
            reg = <1>;

            hdmi0_out_con0: endpoint {
                remote-endpoint = <&hdmi_con0_in>;
            };
          };
        };
      };
    };
```

## Documentation/devicetree/bindings/i2c/i2c-rk3x.txt
```
* Rockchip RK3xxx I2C controller

This driver interfaces with the native I2C controller present in Rockchip
RK3xxx SoCs.

Required properties :

 - reg : Offset and length of the register set for the device
 - compatible : should be "rockchip,rk3x-i2c"
 - interrupts : interrupt number
 - clocks : parent clock
 - rockchip,grf : the phandle of the syscon node for the general register
		  file (GRF)
 - rockchip,bus-index : index of the bus in the GRF

Optional properties :

 - clock-frequency : SCL frequency to use (in Hz). If omitted, 100kHz is used.

Example:

i2c0: i2c@2002d000 {
	compatible = "rockchip,rk3x-i2c";
	reg = <0x2002d000 0x1000>;
	interrupts = <GIC_SPI 40 IRQ_TYPE_LEVEL_HIGH>;
	#address-cells = <1>;
	#size-cells = <0>;

	rockchip,grf = <&grf>;
	rockchip,bus-index = <0>;

	clock-names = "i2c";
	clocks = <&cru PCLK_I2C0>;
};
```

## Documentation/devicetree/bindings/npu/rockchip,rknn.yaml
```yaml
# SPDX-License-Identifier: (GPL-2.0-only OR BSD-2-Clause)
%YAML 1.2
---
$id: http://devicetree.org/schemas/npu/rockchip,rknn.yaml#
$schema: http://devicetree.org/meta-schemas/core.yaml#

title: Neural Processing Unit IP from Rockchip, based on NVIDIA's NVDLA

maintainers:
  - Tomeu Vizoso <tomeu@tomeuvizoso.net>

description: |+
  Rockchip IP for accelerating inference of neural networks, based on NVIDIA's open source NVDLA IP.

properties:
  compatible:
    items:
      - enum:
          - rockchip,rk3588-rknn
      - const: rockchip,rknn

  reg:
    description: Base registers for NPU cores
    minItems: 1
    maxItems: 20

  interrupts:
    minItems: 1
    maxItems: 20

  interrupt-names:
    minItems: 1
    maxItems: 20

  clocks:
    minItems: 1
    maxItems: 20

  clock-names:
    minItems: 1
    maxItems: 20

  assigned-clocks:
    maxItems: 1

  assigned-clock-rates:
    maxItems: 1

  resets:
    minItems: 1
    maxItems: 20

  reset-names:
    minItems: 1
    maxItems: 20

  power-domains:
    minItems: 1
    maxItems: 20

  power-domain-names:
    minItems: 1
    maxItems: 20

  iommus:
    items:
      - description: IOMMU for all cores

required:
  - compatible
  - reg
  - interrupts
  - interrupt-names
  - clocks
  - clock-names
  - assigned-clocks
  - assigned-clock-rates
  - resets
  - reset-names
  - power-domains
  - power-domain-names
  - iommus

additionalProperties: false

examples:
  - |
    #include <dt-bindings/interrupt-controller/arm-gic.h>

    bus {
        #address-cells = <2>;
        #size-cells = <2>;

        rknn: npu@fdab0000 {
          compatible = "rockchip,rk3588-rknn", "rockchip,rknn";
          reg = <0x0 0xfdab0000 0x0 0x9000>,
                <0x0 0xfdac0000 0x0 0x9000>,
                <0x0 0xfdad0000 0x0 0x9000>;
          interrupts = <GIC_SPI 110 IRQ_TYPE_LEVEL_HIGH 0>,
                       <GIC_SPI 111 IRQ_TYPE_LEVEL_HIGH 0>,
                       <GIC_SPI 112 IRQ_TYPE_LEVEL_HIGH 0>;
          interrupt-names = "npu0_irq", "npu1_irq", "npu2_irq";
          clocks = <&scmi_clk 0>, <&cru 1>,
                   <&cru 2>, <&cru 3>,
                   <&cru 4>, <&cru 5>,
                   <&cru 6>, <&cru 7>;
          clock-names = "clk_npu",
                  "aclk0", "aclk1", "aclk2",
                  "hclk0", "hclk1", "hclk2",
                  "pclk";
          assigned-clocks = <&scmi_clk 0>;
          assigned-clock-rates = <200000000>;
          resets = <&cru 0>, <&cru 1>, <&cru 2>,
                   <&cru 3>, <&cru 4>, <&cru 5>;
          reset-names = "srst_a0", "srst_a1", "srst_a2",
                        "srst_h0", "srst_h1", "srst_h2";
          power-domains = <&power 0>, <&power 1>, <&power 2>;
          power-domain-names = "npu0", "npu1", "npu2";
          iommus = <&rknpu_mmu>;
          status = "disabled";
        };
    };
...
```
