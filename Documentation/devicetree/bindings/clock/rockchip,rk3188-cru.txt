## drivers/accel/rocket/Kconfig
```kconfig
# SPDX-License-Identifier: GPL-2.0

config DRM_ACCEL_ROCKET
       tristate "Rocket (DRM support for Rockchip NPUs)"
       depends on DRM
       depends on ARM64 || COMPILE_TEST
       depends on MMU
       select DRM_SCHED
       select IOMMU_SUPPORT
       select IOMMU_IO_PGTABLE_LPAE
       select DRM_GEM_SHMEM_HELPER
       help
         DRM driver for Rockchip NPUs.
```

## drivers/gpu/drm/bridge/ite/Kconfig
```kconfig
config DRM_IT66121
	tristate "ITE it66121 RGB/HDMI bridge"
	depends on OF
	select DRM_KMS_HELPER
	select REGMAP_I2C
	help
	  ITE IT66121 HDMI encoder bridge.

config DRM_IT66121_AUDIO
	bool "IT66121 HDMI Audio driver"
	depends on DRM_IT66121 && SND_SOC
	select SND_SOC_HDMI_CODEC
	help
	  Support the IT66121 HDMI Audio interface. This is used in
	  conjunction with the IT66121 HDMI driver.

config DRM_IT66121_CEC
	bool "IT66121 HDMI CEC driver"
	depends on DRM_IT66121
	select CEC_CORE
	default y
	help
	  When selected the HDMI transmitter will support the CEC feature.
```

## drivers/soc/rockchip/Kconfig
```kconfig
# SPDX-License-Identifier: GPL-2.0-only
if ARCH_ROCKCHIP || COMPILE_TEST

#
# Rockchip Soc drivers
#

config ROCKCHIP_GRF
	bool "Rockchip General Register Files support" if COMPILE_TEST
	default y if ARCH_ROCKCHIP
	help
	  The General Register Files are a central component providing
	  special additional settings registers for a lot of soc-components.
	  In a lot of cases there also need to be default settings initialized
	  to make some of them conform to expectations of the kernel.

config ROCKCHIP_IODOMAIN
	tristate "Rockchip IO domain support"
	depends on OF
	help
	  Say y here to enable support io domains on Rockchip SoCs. It is
	  necessary for the io domain setting of the SoC to match the
	  voltage supplied by the regulators.

config ROCKCHIP_DTPM
	tristate "Rockchip DTPM hierarchy"
	depends on DTPM && m
	help
	  Describe the hierarchy for the Dynamic Thermal Power Management tree
	  on this platform. That will create all the power capping capable
	  devices.

config ROCKCHIP_MFPWM
	tristate "Rockchip multi-function PWM controller"
	depends on OF
	depends on HAS_IOMEM
	help
	  Some Rockchip SoCs, such as the RK3576, use a PWM controller that has
	  several different functions, such as generating PWM waveforms but also
	  counting waveforms.

	  This driver manages the overall device, and selects between different
	  functionalities at runtime as needed, with drivers for them
	  implemented in their respective subsystems.

endif
```
